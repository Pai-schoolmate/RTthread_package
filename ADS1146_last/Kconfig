## ADS1146_last/Kconfig
```kconfig
# Kconfig file for package ADS1146_last
menuconfig PKG_USING_ADS1146_LAST
    bool "Please add description of ADS1146_last in English."
    default n

if PKG_USING_ADS1146_LAST

    config PKG_ADS1146_LAST_PATH
        string
        default "/packages/peripherals/ADS1146_last"

    choice
        prompt "Version"
        default PKG_USING_ADS1146_LAST_LATEST_VERSION
        help
            Select the package version

        config PKG_USING_ADS1146_LAST_V100
            bool "v1.0.0"

        config PKG_USING_ADS1146_LAST_LATEST_VERSION
            bool "latest"
    endchoice

    config PKG_ADS1146_LAST_VER
       string
       default "v1.0.0"    if PKG_USING_ADS1146_LAST_V100
       default "latest"    if PKG_USING_ADS1146_LAST_LATEST_VERSION

endif
```
